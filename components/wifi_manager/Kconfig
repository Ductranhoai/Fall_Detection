## components/wifi_manager/Kconfig
```kconfig
menu "WiFi Manager Configuration"

    config WIFI_MAX_RETRY
        int "Maximum connection retry count"
        default 5
        range 1 10
        help
            Number of times to retry connecting to WiFi before giving up.

    config WIFI_CONNECTION_TIMEOUT
        int "Connection timeout (ms)"
        default 10000
        help
            Timeout for WiFi connection in milliseconds.

endmenu
```
